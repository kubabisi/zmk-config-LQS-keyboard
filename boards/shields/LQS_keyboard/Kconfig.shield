## boards/shields/LQS_keyboard/Kconfig.shield
```kconfig
config SHIELD_LQS_KEYBOARD_LEFT
    def_bool $(shields_list_contains,lqs_keyboard_left)

config SHIELD_LQS_KEYBOARD_RIGHT
    def_bool $(shields_list_contains,lqs_keyboard_right)
```
